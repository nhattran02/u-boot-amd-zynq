## arch/arm/mach-amd-xilinx-zynq/Kconfig
```kconfig
if ARCH_AMD_XILINX_ZYNQ

config SYS_SOC
	default "amd-xilinx-zynq"

config SYS_BOARD
	default "amd-zynq-soc"

config SYS_CONFIG_NAME
	default "amd-zynq-soc"

endif
```

## configs/amd_zynq_soc_defconfig
```kconfig
CONFIG_ARM=y
CONFIG_ARCH_AMD_XILINX_ZYNQ=y
CONFIG_TEXT_BASE=0x4000000
CONFIG_SYS_MALLOC_LEN=0x800000
CONFIG_NR_DRAM_BANKS=1
CONFIG_HAS_CUSTOM_SYS_INIT_SP_ADDR=y
CONFIG_CUSTOM_SYS_INIT_SP_ADDR=0x3ff0000
CONFIG_DEFAULT_DEVICE_TREE="amd-zynq-soc-zc702"
CONFIG_SYS_LOAD_ADDR=0x2000000
CONFIG_DEBUG_UART_BASE=0xe0001000
CONFIG_DEBUG_UART_CLOCK=50000000
CONFIG_DEBUG_UART=y
CONFIG_REMAKE_ELF=y
CONFIG_FIT=y
CONFIG_BOOTSTD_DEFAULTS=y
CONFIG_USE_BOOTARGS=y
CONFIG_BOOTARGS="console=ttyPS0,115200n8"
CONFIG_DEFAULT_FDT_FILE="zynq-zc702.dtb"
CONFIG_CMD_GPIO=y
CONFIG_CMD_MMC=y
CONFIG_CMD_CACHE=y
CONFIG_CMD_TIMER=y
CONFIG_ENV_IS_IN_FAT=y
CONFIG_ENV_FAT_DEVICE_AND_PART="0:auto"
CONFIG_NET_RANDOM_ETHADDR=y
CONFIG_MMC_SDHCI_ADMA=y
CONFIG_PHY_MARVELL=y
CONFIG_DEBUG_UART_ANNOUNCE=y
```
